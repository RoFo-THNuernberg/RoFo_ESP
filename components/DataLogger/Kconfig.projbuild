## components/DataLogger/Kconfig.projbuild
```kconfig
menu "Data Logger"

    config DATA_LOG_SAMPLE_SIZE
        int "log sample size"
        default 64
        help
            Maximum log sample size per call to macro LOG_DATA().
            Big values will lead to wasted heap memory.
            Adjust value according to your maximum log sample.

    config DATA_LOG_BUFFER_SIZE
        int "log buffer size"
        default 2048
        help
            Size of each heap buffer, which stores the data logs.
            Small values will lead to many heap allocations.
            

endmenu
```

## components/RosBridgeClient/Kconfig.projbuild
```kconfig
menu "RosBridgeClient"

    config INIT_ID  
            int "init id"
            range 0 255
            default 1
            help
                id for initializing external node
                
    config ADVERTISE_ID   
        int "advertise id"
        range 0 255
        default 17
        help
            id for "advertise topic" tcp packets

    config PUBLISH_ID   
        int "publish id"
        range 0 255
        default 18
        help
            id for "publish topic" tcp packets
endmenu
```

## components/Socket/Kconfig.projbuild
```kconfig
menu "Socket Configuration"

    config SERVER_IP_ADDR
        string "Server IP address"
        default "0.0.0.0"
        help
            The client will connect to this IPV4 address.

    config SOCKET_PORT
        int "Socket Port"
        range 0 65535
        default 3333
        help
            Port for tcp/udp socket communication

    config SOCKET_PROTOCOL
        string "Socket Protocol"
        default tcp
        help
            Select protocol (udp, tcp)


    config TX_QUEUE_SIZE
        int "tx queue size"
        default 32
        help
            set the max amount of messages to be stored in the tx_queue
endmenu
```

## main/Kconfig.projbuild
```kconfig
menu "Socket Configuration"

    config SERVER_IP_ADDR
        string "Server IP"
        default "192.168.1.119"
        help
            The client will connect to this IPV4 address.

    config ROS_SOCKET_PORT
        int 2888
        range 0 65535
        default 2888
        help
            Port for tcp/udp socket communication

endmenu
```
